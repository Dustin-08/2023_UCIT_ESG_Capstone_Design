// 1. 라이브러리 선언 구문--------------------------------------------------------------------
#include<SoftwareSerial.h> // 블루투스를 활용하기 위한 라이브러리 선언

// 2. 변수 선언 구문-----------------------------------------------------------------------------
#define led         9 // led를 D9로 설정
#define BTtx       7 // 블루투스 모듈의 tx를 D7으로 설정
#define BTrx       8 // 블루투스 모듈의 rx를 D8로 설정

SoftwareSerial BT(BTtx, BTrx); // tx, rx

char data = 0; /* 앱을 통해 0 또는 1이라는 문자열을 받을건데 
0이 꺼지는 default 값이므로 0으로 설정 */

// 3. 초기 선언 구문--------------------------------------------------------------------------
void setup() {
  BT.begin(9600); // BT를 보드레이트 9600으로 설정
  Serial.begin(9600); // 시리얼 모니터의 보드레이트를 9600으로 설정
  pinMode(led, OUTPUT); // led 핀을 출력 모드로 설정
}

// 4. 반복 구문----------------------------------------------------------------------------------
void loop() {
  // 5. 블루투스 모듈 수신 확인용----------------------------------------------------------
  if(BT.available() > 0) { // 블루투스가 연결되면
    data = BT.read(); // 데이터를 수신 받아서 읽음
  }
  // 6. 실제 문자열에 따라 작동하는 구문-------------------------------------------------
  if(data == '1') { // data라는 문자열이 1이라면
    digitalWrite(led, LOW); // led가 꺼짐
    Serial.println("Turn OFF"); // 시리얼 모니터에 Turn OFF라는 문구 출력
  }
  else if(data == '0') { // data라는 문자열이 0이라면
    digitalWrite(led, HIGH); // led가 켜짐
    Serial.println("Turn ON"); // 시리얼 모니터에 Turn ON이라는 문구 출력
  }
  // 7. 문자열 초기화----------------------------------------------------------------------------
  data = 0; // data라는 문자열을 초기화
}
